#include <Wire.h>
#include <Adafruit_GFX.h>
#include <Adafruit_SSD1306.h>
#include <NewPing.h>

// OLED display dimensions
#define SCREEN_WIDTH 128
#define SCREEN_HEIGHT 64
#define SCREEN_I2C_ADDR 0x3C
#define OLED_RST_PIN -1
Adafruit_SSD1306 display(SCREEN_WIDTH, SCREEN_HEIGHT, &Wire, OLED_RST_PIN);

// Ultrasonic Sensor pins and max distance
#define TRIG_PIN 5
#define ECHO_PIN 18
#define MAX_DISTANCE 300
NewPing sonar(TRIG_PIN, ECHO_PIN, MAX_DISTANCE);

// Animation parameters
#define FRAME_DELAY (30) // Animation speed
#define FRAME_WIDTH (64)
#define FRAME_HEIGHT (64)
#define FRAME_COUNT (sizeof(frames) / sizeof(frames[0]))
const byte PROGMEM frames[][512] = {
    // Add Wokwi-generated bitmap data here
    {0, 0, 0, 0, 0, 0, 0, 0, 0, 0, 0, 0, 0,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 0, 0},
    {0, 0, 0, 0, 0, 0, 0, 0, 0, 0, 0, 0, 0,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 0, 0},
    {0, 0, 0, 0, 0, 0, 0, 0, 0, 0, 0, 0, 0,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 0, 0},
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    {0, 0, 0, 0, 0, 0, 0, 0, 0, 0, 0, 0, 0,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 0, 0}};

// Distance threshold for triggering animation
const int DISTANCE_THRESHOLD_ANIMATION = 10;
const int DISTANCE_THRESHOLD_BEEP1 = 5;
const int DISTANCE_THRESHOLD_BEEP2 = 10;
const int DISTANCE_THRESHOLD_BEEP3 = 20;
int frame = 0;

// LED pin definition
const int LED_PIN = 2; // Change if your built-in LED is on a different pin

const int BUZZER_PIN = 25; // Change if your buzzer is on a different pin

// LED control timing
unsigned long previousMillis = 0;
const long ledInterval = 250; // LED flash interval (in milliseconds)
bool ledState = LOW;          // Current state of the LED

unsigned long buzzerMillis = 0;
long buzzerInterval = 200; // Buzzer beep interval (in milliseconds)
bool buzzerState = LOW;    // Current state of the buzzer

void setup()
{
    display.begin(SSD1306_SWITCHCAPVCC, SCREEN_I2C_ADDR);
    display.clearDisplay();
    Serial.begin(115200);

    pinMode(LED_PIN, OUTPUT);    // Set the LED pin as output
    pinMode(BUZZER_PIN, OUTPUT); // Set the buzzer pin as output
}

void loop()
{
    // Get distance from the ultrasonic sensor
    int distance = sonar.ping_cm();

    // Clear display for the next frame
    display.clearDisplay();

    // Check if distance is within threshold for animation
    if (distance > 0 && distance <= DISTANCE_THRESHOLD_ANIMATION)
    {
        // Handle LED blinking separately
        unsigned long currentMillis = millis();
        if (currentMillis - previousMillis >= ledInterval)
        {
            previousMillis = currentMillis;  // Save the last time LED was updated
            ledState = !ledState;            // Toggle the LED state
            digitalWrite(LED_PIN, ledState); // Update the LED state
        }

        // Display the animation frame
        display.drawBitmap(32, 0, frames[frame], FRAME_WIDTH, FRAME_HEIGHT, 1);
        display.display();
        frame = (frame + 1) % FRAME_COUNT; // Update frame
        delay(FRAME_DELAY);                // Animation delay
    }
    else
    {
        // Show distance text if not within threshold
        display.setTextSize(1);
        display.setTextColor(WHITE);
        display.setCursor(0, 0);
        display.println("Distance");

        display.setCursor(0, 20);
        if (distance > 0)
        {
            display.print(distance);
            display.println(" cm");
            Serial.print("Distance: ");
            Serial.print(distance);
            Serial.println(" cm");
        }
        else
        {
            display.println("Out of Range");
            Serial.println("Out of Range");
        }
        display.display();
        delay(500); // Delay for text display
    }

    // Check if distance is within threshold for beeping
    // Buzzer Logic Based on Distance
    unsigned long currentMillis = millis();
    if (distance > 0 && distance <= DISTANCE_THRESHOLD_BEEP3)
    {
        if (distance <= DISTANCE_THRESHOLD_BEEP1)
        {
            buzzerInterval = 50; // Fast beeps (high frequency)
        }
        else if (distance <= DISTANCE_THRESHOLD_BEEP2)
        {
            buzzerInterval = 100; // Medium beeps
        }
        else if (distance <= DISTANCE_THRESHOLD_BEEP3)
        {
            buzzerInterval = 200; // Slow beeps (long gap)
        }

        // Toggle buzzer state based on interval
        if (currentMillis - buzzerMillis >= buzzerInterval)
        {
            buzzerMillis = currentMillis;          // Save last time buzzer was updated
            buzzerState = !buzzerState;            // Toggle buzzer state
            digitalWrite(BUZZER_PIN, buzzerState); // Update buzzer state
        }
    }
    else
    {
        // Turn off buzzer if out of range or above threshold
        digitalWrite(BUZZER_PIN, LOW);
    }
}
